## boards/shields/D63-TW/Kconfig.defconfig
```kconfig
if SHIELD_D63-TW_RIGHT

config ZMK_KEYBOARD_NAME
	default "D63-TW"

config ZMK_SPLIT_ROLE_CENTRAL
	default y

endif

if SHIELD_D63-TW_LEFT || SHIELD_D63-TW_RIGHT

config ZMK_SPLIT
	default y

config ZMK_POINTING
	default y

endif
```

## boards/shields/D63-TW/Kconfig.shield
```kconfig
config SHIELD_D63-TW_LEFT
	def_bool $(shields_list_contains,D63-TW_left)

config SHIELD_D63-TW_RIGHT
	def_bool $(shields_list_contains,D63-TW_right)
```

## config/west.yml
```yaml
manifest:
  remotes:
    - name: zmkfirmware
      url-base: https://github.com/zmkfirmware
    - name: joelspadin
      url-base: https://github.com/joelspadin
    - name: badjeff
      url-base: https://github.com/badjeff
  projects:
    - name: zmk
      remote: zmkfirmware
      revision: main
      import: app/west.yml
    - name: zmk-locales
      remote: joelspadin
      revision: main
    - name: zmk-pmw3610-driver
      remote: badjeff
      revision: main
  self:
    path: config
```
