## boards/shields/D63TW/Kconfig.defconfig
```kconfig
if SHIELD_D63TW_RIGHT

config ZMK_KEYBOARD_NAME
	default "D63TW"

config ZMK_SPLIT_ROLE_CENTRAL
	default y

endif

if SHIELD_D63TW_LEFT || SHIELD_D63TW_RIGHT

config ZMK_SPLIT
	default y

config ZMK_POINTING
	default y

endif
```
